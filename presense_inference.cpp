/*
 * presense_inference.cpp
 * ==============================================================================
 * PreSense - Predictive Sensory Augmentation Platform for Peripheral Neuropathy
 * Lead Developer: Tanmay Das
 * ------------------------------------------------------------------------------
 * TFLite Micro runtime for the INT8-quantized PreSense gait model.
 *
 * Per 10 ms tick:
 *   SensorFrame -> min-max normalize (train-time constants)
 *               -> push into 128 x 11 ring buffer
 *               -> when full: quantize to int8 -> interpreter->Invoke()
 *               -> dequantize softmax -> threshold -> bool decision
 *
 * The model weights are linked from presense_motion_model.h (generated by
 * motion_model_training.py).
 * ==============================================================================
 */

#include "presense_inference.h"
#include "presense_motion_model.h"   // presense_motion_model_tflite[]

#include <Arduino.h>
#include <cstring>
#include <cmath>

// TFLite Micro (install "TensorFlowLite_ESP32" via Library Manager, or use
// the ESP-IDF tflite-micro component)
#include "tensorflow/lite/micro/micro_interpreter.h"
#include "tensorflow/lite/micro/micro_mutable_op_resolver.h"
#include "tensorflow/lite/micro/system_setup.h"
#include "tensorflow/lite/schema/schema_generated.h"

// ===================== MODEL / BUFFER GEOMETRY ==============================
static constexpr uint16_t WINDOW_LEN    = 128;  // samples per inference window
static constexpr uint16_t N_FEATURES    = 11;   // MUST match training order:
//   acc_x, acc_y, acc_z, gyro_x, gyro_y, gyro_z,
//   fsr_heel, fsr_toe_left, fsr_toe_right, fsr_mid, altitude_delta
static constexpr uint16_t N_CLASSES     = 2;

// Tensor arena. If AllocateTensors() fails, bump in 4 KB steps.
static constexpr uint32_t TENSOR_ARENA_SIZE = 48 * 1024;
alignas(16) static uint8_t tensor_arena[TENSOR_ARENA_SIZE];

// ===================== TFLM OBJECTS =========================================
static tflite::MicroInterpreter*  interpreter = nullptr;
static const tflite::Model*       model       = nullptr;
static TfLiteTensor*              input       = nullptr;
static TfLiteTensor*              output      = nullptr;

// Quantization params, read from the model at init
static float in_scale       = 1.0f;
static int   in_zero_point  = 0;
static float out_scale      = 1.0f;
static int   out_zero_point = 0;

// ===================== RING BUFFER ==========================================
// Normalized float32 features, ring-buffered; linearized oldest->newest
// only at inference time.
static float    ring_buf[WINDOW_LEN][N_FEATURES];
static uint16_t ring_head  = 0;   // next write position
static uint16_t ring_count = 0;   // samples stored (caps at WINDOW_LEN)

// Reusable quantized input window (avoids per-call allocation)
static int8_t   q_window[WINDOW_LEN * N_FEATURES];

// ===================== NORMALIZATION (train-time constants) =================
// These MUST match the min/max fitted on the TRAIN split in
// motion_model_training.py. The training script prints the exact values
// at the end of a run - paste them here.
//
// TODO(tanmay): replace with the printed constants from your training run.
// Values below cover the synthetic generator's ranges with a small margin.
static const float FEAT_MIN[N_FEATURES] = {
  -1.60f,  -0.60f,  -0.40f,       // acc_x, acc_y, acc_z        (g)
  -140.0f, -120.0f, -160.0f,      // gyro_x, gyro_y, gyro_z     (deg/s)
    0.0f,    0.0f,    0.0f,       // fsr_heel, fsr_toe_left, fsr_toe_right
    0.0f,                         // fsr_mid
   -0.05f                         // altitude_delta             (m)
};
static const float FEAT_MAX[N_FEATURES] = {
   1.60f,   0.60f,   2.60f,       // acc_x, acc_y, acc_z
  140.0f,  300.0f,  160.0f,       // gyro_x, gyro_y, gyro_z
 1023.0f, 1023.0f, 1023.0f,       // fsr_heel, fsr_toe_left, fsr_toe_right
 1023.0f,                         // fsr_mid
   0.20f                          // altitude_delta
};

// ===================== DECISION POLICY ======================================
// Softmax probability threshold for class 1 (Hesitation / Foot Drop).
static constexpr float INSTABILITY_THRESHOLD = 0.60f;

// Run inference every Nth sample tick once warmed. 2 -> 50 Hz decision rate
// inside the 100 Hz sampling loop; the last decision is held between runs.
static constexpr uint8_t INFERENCE_STRIDE = 2;

// ===================== STATE ================================================
static bool     s_initialized      = false;
static float    s_last_probability = 0.0f;
static uint32_t s_last_latency_us  = 0;
static bool     s_last_decision    = false;
static uint16_t s_ticks_since_inf  = 0;

// ===================== OP RESOLVER ==========================================
// Register only the ops the CNN actually uses -> smaller binary, faster init.
// NOTE: Conv1D and GlobalAveragePooling1D lower to Conv2D / AveragePool2D
// in the exported flatbuffer, hence the 2D registrations below.
static tflite::MicroMutableOpResolver<8>& getResolver() {
  static tflite::MicroMutableOpResolver<8> resolver;
  static bool registered = false;
  if (!registered) {
    resolver.AddConv2D();
    resolver.AddMaxPool2D();
    resolver.AddAveragePool2D();
    resolver.AddFullyConnected();
    resolver.AddSoftmax();
    resolver.AddReshape();
    resolver.AddRelu();
    resolver.AddQuantize();      // some exports insert Quantize/Dequantize
    registered = true;
  }
  return resolver;
}

// ===================== INIT =================================================
bool inference_init() {
  tflite::InitializeTarget();    // ESP32 debug-output plumbing

  model = tflite::GetModel(presense_motion_model_tflite);
  if (model->version() != TFLITE_SCHEMA_VERSION) {
    Serial.printf("[TFLM] Schema mismatch: model v%u vs runtime v%u\n",
                  (unsigned)model->version(), (unsigned)TFLITE_SCHEMA_VERSION);
    return false;
  }

  static tflite::MicroInterpreter static_interpreter(
      model, getResolver(), tensor_arena, TENSOR_ARENA_SIZE);
  interpreter = &static_interpreter;

  if (interpreter->AllocateTensors() != kTfLiteOk) {
    Serial.printf("[TFLM] AllocateTensors FAILED (arena used %u of %u bytes). "
                  "Increase TENSOR_ARENA_SIZE.\n",
                  (unsigned)interpreter->arena_used_bytes(),
                  (unsigned)TENSOR_ARENA_SIZE);
    return false;
  }

  input  = interpreter->input(0);
  output = interpreter->output(0);

  // Validate expected geometry: [1, 128, 11] in, [1, 2] out
  if (input->dims->size != 3 ||
      input->dims->data[1] != WINDOW_LEN ||
      input->dims->data[2] != N_FEATURES) {
    Serial.printf("[TFLM] Unexpected input shape: dims=%d -> [%d,%d,%d]\n",
                  input->dims->size,
                  input->dims->size > 0 ? input->dims->data[0] : -1,
                  input->dims->size > 1 ? input->dims->data[1] : -1,
                  input->dims->size > 2 ? input->dims->data[2] : -1);
    return false;
  }

  in_scale       = input->params.scale;
  in_zero_point  = input->params.zero_point;
  out_scale      = output->params.scale;
  out_zero_point = output->params.zero_point;

  Serial.printf("[TFLM] Model %u bytes | arena used %u / %u bytes\n",
                (unsigned)presense_motion_model_tflite_len,
                (unsigned)interpreter->arena_used_bytes(),
                (unsigned)TENSOR_ARENA_SIZE);
  Serial.printf("[TFLM] Input  quant: scale=%.6f zp=%d\n",
                in_scale, in_zero_point);
  Serial.printf("[TFLM] Output quant: scale=%.6f zp=%d\n",
                out_scale, out_zero_point);

  s_initialized = true;
  return true;
}

// ===================== HELPERS ==============================================
static inline float normalize_feature(uint8_t idx, float raw) {
  const float range = FEAT_MAX[idx] - FEAT_MIN[idx];
  if (range <= 0.0f) return 0.0f;
  float v = (raw - FEAT_MIN[idx]) / range;
  if (v < 0.0f) v = 0.0f;      // clamp to training bounds: keeps int8
  if (v > 1.0f) v = 1.0f;      // quantization from saturating off-scale
  return v;
}

static inline void ring_push(const float* feats) {
  std::memcpy(ring_buf[ring_head], feats, N_FEATURES * sizeof(float));
  ring_head = (uint16_t)((ring_head + 1) % WINDOW_LEN);
  if (ring_count < WINDOW_LEN) ring_count++;
}

// Linearize ring (oldest -> newest) and quantize into the input tensor.
static void build_quantized_input() {
  const uint16_t start = ring_head;   // ring is full: head == oldest sample
  int8_t* dst = input->data.int8;
  for (uint16_t i = 0; i < WINDOW_LEN; i++) {
    const uint16_t src = (uint16_t)((start + i) % WINDOW_LEN);
    for (uint16_t c = 0; c < N_FEATURES; c++) {
      int32_t q = (int32_t)lroundf(ring_buf[src][c] / in_scale) + in_zero_point;
      if (q < -128) q = -128;
      if (q >  127) q =  127;
      dst[i * N_FEATURES + c] = (int8_t)q;
    }
  }
}

// ===================== PUBLIC API ===========================================
bool predict_instability(const SensorFrame& f) {
  if (!s_initialized) return false;

  // 1) Normalize raw frame into model-ordered feature vector
  float feats[N_FEATURES];
  feats[0]  = normalize_feature(0,  f.acc_x);
  feats[1]  = normalize_feature(1,  f.acc_y);
  feats[2]  = normalize_feature(2,  f.acc_z);
  feats[3]  = normalize_feature(3,  f.gyro_x);
  feats[4]  = normalize_feature(4,  f.gyro_y);
  feats[5]  = normalize_feature(5,  f.gyro_z);
  feats[6]  = normalize_feature(6,  (float)f.fsr_heel);
  feats[7]  = normalize_feature(7,  (float)f.fsr_toe_left);
  feats[8]  = normalize_feature(8,  (float)f.fsr_toe_right);
  feats[9]  = normalize_feature(9,  (float)f.fsr_mid);
  feats[10] = normalize_feature(10, f.altitude_delta);

  ring_push(feats);

  // 2) Warmup gate: need a full 128-sample window before first inference
  if (ring_count < WINDOW_LEN) {
    s_last_decision = false;
    return false;
  }

  // 3) Stride gate: hold last decision between inference runs
  if (++s_ticks_since_inf < INFERENCE_STRIDE) {
    return s_last_decision;
  }
  s_ticks_since_inf = 0;

  // 4) Quantize window directly into the input tensor
  build_quantized_input();

  // 5) Invoke
  const uint32_t t0 = micros();
  if (interpreter->Invoke() != kTfLiteOk) {
    Serial.println(F("[TFLM] Invoke() failed - holding last decision"));
    return s_last_decision;
  }
  s_last_latency_us = micros() - t0;

  // 6) Dequantize softmax output -> probability of class 1
  const int8_t q_out = output->data.int8[1];
  s_last_probability = (q_out - out_zero_point) * out_scale;

  // 7) Threshold decision
  s_last_decision = (s_last_probability >= INSTABILITY_THRESHOLD);

  if (s_last_decision) {
    Serial.printf("[TFLM] INSTABILITY p=%.3f (thr=%.2f) invoke=%lu us\n",
                  s_last_probability, INSTABILITY_THRESHOLD,
                  (unsigned long)s_last_latency_us);
  }
  return s_last_decision;
}

float    inference_last_probability() { return s_last_probability; }
uint32_t inference_last_latency_us()  { return s_last_latency_us; }
uint16_t inference_buffer_fill()      { return ring_count; }
